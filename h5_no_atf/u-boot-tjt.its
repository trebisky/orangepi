## h5_no_atf/u-boot-tjt.its
```
/dts-v1/;

/ {
	description = "Configuration to **bypass** ATF before U-Boot";
	#address-cells = <1>;

	images {
		uboot {
			description = "U-Boot (64-bit)";
			data = /incbin/("u-boot.bin");
			type = "standalone";
			arch = "arm64";
			compression = "none";
			load = <0x4a000000>;
		};
		atf {
			description = "Switch to EL2, stay secure";
			data = /incbin/("switch_el.bin");
			type = "firmware";
			arch = "arm64";
			compression = "none";
			load = <0x44000>;
			entry = <0x44000>;
		};
		fdt_1 {
			description = "sun50i-h5-orangepi-pc2";
			data = /incbin/("sun50i-h5-orangepi-pc2.dtb");
			type = "flat_dt";
			compression = "none";
		};
	};
	configurations {
		default = "config_1";

		config_1 {
			description = "sun50i-h5-orangepi-pc2";
			firmware = "uboot";
			loadables = "atf";
			fdt = "fdt_1";
		};
	};
};
```
